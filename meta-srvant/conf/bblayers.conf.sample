## meta-srvant/conf/bblayers.conf.sample
```bitbake
# LAYER_CONF_VERSION is increased each time build/conf/bblayers.conf
# changes incompatibly
LCONF_VERSION = "7"

BBPATH = "${TOPDIR}"
BBFILES ?= ""

BBLAYERS ?= " \
  ##OEROOT##/meta \
  ##OEROOT##/meta-poky \
  ##OEROOT##/meta-openembedded/meta-oe \
  ##OEROOT##/meta-openembedded/meta-networking \
  ##OEROOT##/meta-openembedded/meta-perl \
  ##OEROOT##/meta-openembedded/meta-python \
  ##OEROOT##/meta-phosphor \
  ##OEROOT##/meta-arm \
  ##OEROOT##/meta-srvant \
  "
BBLAYERS_NON_REMOVABLE ?= " \
  ##OEROOT##/meta \
  ##OEROOT##/meta-poky \
  ##OEROOT##/meta-openembedded/meta-oe \
  ##OEROOT##/meta-openembedded/meta-networking \
  ##OEROOT##/meta-openembedded/meta-perl \
  ##OEROOT##/meta-openembedded/meta-python \
  ##OEROOT##/meta-phosphor \
  ##OEROOT##/meta-arm \
  ##OEROOT##/meta-srvant \
  "
```

## meta-srvant/conf/machine/include/tune-arm1176jzf-s.inc
```bitbake
PREFERRED_PROVIDER_virtual/kernel ?= "linux-arm"
PREFERRED_PROVIDER_virtual/bootloader ?= "u-boot-arm"

DEFAULTTUNE ?= "armv7"

SERIAL_CONSOLES = "115200;ttyS0"


require conf/machine/include/arm/arch-armv7.inc
```

## meta-srvant/conf/machine/srvant-pi-a13.conf
```bitbake
DEFAULTTUNE ?= "armv7a"

require conf/machine/include/arm/arch-armv7a.inc

VIRTUAL-RUNTIME_skeleton_workbook = "${MACHINE}-config"
KERNEL_DEVICETREE = "sun5i-a13.dtsi"

UBOOT_MACHINE ?= "A13-OLinuXino_defconfig"

PHOSPHOR_MRW_LICENSE = "Apache-2.0"
PHOSPHOR_MRW_LIC_FILES_CHKSUM = "file://LICENSE;md5=e3fc50a88d0a364313df4b21ef20c29e"
PHOSPHOR_MRW_URI = "git://github.com/open-power/romulus-xml"
PHOSPHOR_MRW_REV = "14b471fbf37f5fb60261de001df83caf5f96d81f"

PREFERRED_PROVIDER_virtual/openpower-occ-control-config-native = "romulus-occ-control-config-native"
PREFERRED_PROVIDER_virtual/phosphor-led-manager-config-native = "romulus-led-manager-config-native"
PREFERRED_PROVIDER_virtual/phosphor-logging-callouts = "romulus-phosphor-logging-callouts-native"
```

## meta-srvant/meta-sonny/conf/layer.conf
```bitbake
# We have a conf and classes directory, add to BBPATH
BBPATH .= ":${LAYERDIR}"

# We have recipes-* directories, add to BBFILES
BBFILES += "${LAYERDIR}/recipes-*/*/*.bb \
            ${LAYERDIR}/recipes-*/*/*.bbappend"

BBFILE_COLLECTIONS += "sonny"
BBFILE_PATTERN_sonny := "^${LAYERDIR}/"
LAYERSERIES_COMPAT_sonny = "dunfell gatesgarth"
```

## meta-srvant/meta-sonny/conf/local.conf.sample
```bitbake
MACHINE ??= "sonny"
DISTRO ?= "openbmc-phosphor"

PACKAGE_CLASSES ?= "package_rpm"
SANITY_TESTED_DISTROS_append ?= " *"
EXTRA_IMAGE_FEATURES = "debug-tweaks"
USER_CLASSES ?= "buildstats image-mklibs image-prelink"
PATCHRESOLVE = "noop"
BB_DISKMON_DIRS = "\
    STOPTASKS,${TMPDIR},1G,100K \
    STOPTASKS,${DL_DIR},1G,100K \
    STOPTASKS,${SSTATE_DIR},1G,100K \
    STOPTASKS,/tmp,100M,100K \
    ABORT,${TMPDIR},100M,1K \
    ABORT,${DL_DIR},100M,1K \
    ABORT,${SSTATE_DIR},100M,1K \
    ABORT,/tmp,10M,1K"

PACKAGECONFIG_append_pn-qemu-native = " sdl"
PACKAGECONFIG_append_pn-nativesdk-qemu = " sdl"

CONF_VERSION = "1"

INHERIT += "extrausers"
EXTRA_USERS_PARAMS = " \
  useradd -p '' tester; \
  usermod -s /bin/sh tester; \
  usermod -p '\$1\$UGMqyqdG\$FZiylVFmRRfl9Z0Ue8G7e/' root; \
  "
```

## meta-srvant/meta-sonny/conf/machine/sonny_a13.conf
```bitbake
DEFAULTTUNE ?= "armv7a"

KERNEL_DEVICETREE = "sun5i-a13-srvant-${MACHINE}.dtb"
UBOOT_MACHINE = "A13-bmc-srvant_defconfig"
UBOOT_DEVICETREE = "sun5i-a13-bmc-srvant-${MACHINE}"
# SPL_BINARY ?= "spl/u-boot-sunxi-with-spl.bin"
UBOOT_BINARY ?= "u-boot-sunxi-with-spl.bin"

require conf/machine/include/arm/arch-armv7a.inc

PREFERRED_PROVIDER_virtual/kernel ?= "linux-obmc"
PREFERRED_PROVIDER_virtual/bootloader ?= "u-boot"
PREFERRED_PROVIDER_u-boot ?= "u-boot"

PREFERRED_PROVIDER_virtual/phosphor-led-manager-config-native = "sonny-led-manager-config-native"
```
